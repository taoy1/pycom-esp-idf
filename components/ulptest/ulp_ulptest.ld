/* Variable definitions for ESP32ULP linker
 * This file is generated automatically by esp32ulp_mapgen.py utility.
 */

PROVIDE ( ulp_buf_sensor_1 = 0x500003c8 );
PROVIDE ( ulp_buf_sensor_4_pp0 = 0x50000320 );
PROVIDE ( ulp_buf_sensor_4_pp1 = 0x50000370 );
PROVIDE ( ulp_entry = 0x50000000 );
PROVIDE ( ulp_exit = 0x500000e0 );
PROVIDE ( ulp_pingpong = 0x500002f8 );
PROVIDE ( ulp_reverse_wakeup = 0x500002e0 );
PROVIDE ( ulp_run_cnt_pp0 = 0x500002f0 );
PROVIDE ( ulp_run_cnt_pp0_a = 0x500002fc );
PROVIDE ( ulp_run_cnt_pp0_b = 0x50000304 );
PROVIDE ( ulp_run_cnt_pp0_c = 0x5000030c );
PROVIDE ( ulp_run_cnt_pp1 = 0x500002f4 );
PROVIDE ( ulp_run_cnt_pp1_a = 0x50000300 );
PROVIDE ( ulp_run_cnt_pp1_b = 0x50000308 );
PROVIDE ( ulp_run_cnt_pp1_c = 0x50000310 );
PROVIDE ( ulp_wake_up = 0x500000e4 );
